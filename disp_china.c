uint8_t pic240128[]=
{
/*--  ERC240120-3SERIES.bmp  --*/
/*--  240x128  --*/
0xFF,0x01,0x01,0x01,0x01,0x01,0x01,0x01,0x01,0x01,0x01,0x01,0x01,0x01,0x01,0x01,
0x01,0x01,0x01,0x01,0x01,0x01,0x01,0x01,0x01,0x01,0x01,0x01,0x01,0x01,0x01,0x01,
0x01,0x01,0x01,0x01,0x01,0x01,0x01,0x01,0x01,0x01,0x01,0x01,0x01,0x01,0x01,0x01,
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0xA2,0xA2,0x9D,0x80,0x80,0xB8,0x86,0x81,0x80,0x80,0x8C,0x8B,0x88,0xBF,0x88,0xFF,

};

void delay_step(void)
{
	for (uint8_t i = 0; i < 100; i++)
	{
		__NOP();
	}
}

void Write_Instruction(uint8_t cmd)
{
	SET_CS;
    RESET_DC;
    //HAL_SPI_Transmit(&hspi1, &inst, 1, 100);
    SET_SCK;
    for(uint8_t i=0;i<8;i++)
	{
    	RESET_SCK;//SCK=0;
    	delay_step();
		if(cmd&0x80) SET_SDA;
		else RESET_SDA;
		cmd=cmd<<1;
		delay_step();
		SET_SCK;//SCK=1;
		delay_step();
	}
    SET_CS;
}

void Write_Data(uint8_t cmd)
{
	SET_CS;
    SET_DC;
    //HAL_SPI_Transmit(&hspi1, &inst, 1, 100);
    SET_SCK;
    for(uint8_t i=0;i<8;i++)
	{
    	RESET_SCK;//SCK=0;
    	delay_step();
		if(cmd&0x80) SET_SDA;
		else RESET_SDA;
		cmd=cmd<<1;
		delay_step();
		SET_SCK;//SCK=1;
		delay_step();
	}
    SET_CS;
}

// Set page address 0~15
void Set_Page_Address(uint8_t add)
{
    add = 0xb0 | add;
    Write_Instruction(add);
	return;
}
// Set column address
void Set_Column_Address(uint8_t add)
{
    Write_Instruction((0x10 | (add>>4)));
	Write_Instruction((0x0f & add));
	return;
}

void Set_Contrast_Control_Register(unsigned char mod)
{
    Write_Instruction(0x81);
	Write_Instruction(mod|0x00);
	return;
}

void Initial(void)
{
	//SET_RS;//RST=1;
	HAL_Delay(20);
	RESET_RS;//RST=0;
	HAL_Delay(20);
	SET_RS;//RST=1;
	HAL_Delay(20);

	/*Write_Instruction(0x00);
	Write_Instruction(0x10);
	Write_Instruction(0x40);
	Write_Instruction(0x24);
	Write_Instruction(0x2D);
	Write_Instruction(0x81);
	Write_Instruction(0x80);
	Write_Instruction(0x89);
	Write_Instruction(0xA4);
	Write_Instruction(0xA4);
	Write_Instruction(0xAF);
	Write_Instruction(0xCC);
	Write_Instruction(0xEA);
	Write_Instruction(0x90);*/

	//	Write_Instruction(0xE2);//system reset
	//Write_Instruction(0xE2);//system reset
	//HAL_Delay(200);
	Write_Instruction(0x27);// Multiples rate :128   set temperature consenpation

   	Write_Instruction(0xC8);//set LCD mapping control   MX=0,MY=1

	Write_Instruction(0xEA);//set bias:1/12bias

	Write_Instruction(0x81);//Set Gain and Potentiometer
	Write_Instruction((uint8_t)26);//Set Gain and Potentiometer  xx xxxxxx

	Write_Instruction(0x2D);//Power Control:internal
	HAL_Delay(20);


	Write_Instruction(0xA4);//--set normal display
//	Write_Instruction(0xA5);//--set  all pixel on
	Write_Instruction(0xA6);//--set normal display
//	Write_Instruction(0xA7);//--set inverse display

	Write_Instruction(0x89);//set RAM Address control

//    Write_Instruction(0x90);//set fixed lines      1001xxxx
	Write_Instruction(0x40);//Set Start Line
    Write_Instruction(0xB0);//set pageaddress
     Write_Instruction(0xAf);//set Display Enable

}

void Clear_Display(void)
{
	uint8_t i,j;
	for(i=0;i<16;i++)
	{
		Set_Page_Address(i);
		Set_Column_Address(0x00);
        for(j=0;j<240;j++)
		{
		    Write_Data(0x0F);
		}
	}
	 Write_Instruction(0xAf);
}

void Display_Picture(void)
{
	uint8_t i,j,num=0;
	for(i=0;i<16;i++)
	{
		Set_Page_Address(i);
		Set_Column_Address(0x00);
        for(j=0;j<240;j++)
		{
		    Write_Data(pic240128[(uint16_t)num*240+j]);
		}
		num++;
	}
	 Write_Instruction(0xAf);
}
